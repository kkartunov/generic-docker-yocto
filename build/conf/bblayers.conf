## build/conf/bblayers.conf
```bitbake
# POKY_BBLAYERS_CONF_VERSION is increased each time build/conf/bblayers.conf
# changes incompatibly
POKY_BBLAYERS_CONF_VERSION = "1"

BBPATH = "${TOPDIR}"
BBFILES ?= ""

BBLAYERS ?= " \
    /home/builder/poky/meta \
    /home/builder/poky/meta-poky \
    /home/builder/poky/meta-yocto \
    /home/builder/poky/meta-yocto-bsp \
    /home/builder/poky/meta-openembedded/meta-oe \    
  "
```

## build/conf/local.conf
```bitbake
# Local configuration for Yocto Project 2.2 Poky distribution [morty] branch

LICENSE_FLAGS_WHITELIST = "commercial"
DISTRO = "poky"
PACKAGE_CLASSES = "package_ipk"
SDKMACHINE = "x86_64"
PATCHRESOLVE = "noop"
CONF_VERSION = "1"

# Speed builds. Set to 2x cores count for best results
BB_NUMBER_THREADS = "8"
PARALLEL_MAKE = "-j 8"
```
